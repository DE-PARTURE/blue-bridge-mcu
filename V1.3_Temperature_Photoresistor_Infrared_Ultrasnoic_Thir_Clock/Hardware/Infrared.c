/**************************************************/
/*	需使用杜邦线将P1^1和P3^3短接									*/
/**************************************************/
#include "Sys.h"

bit irflag = 0;

u8 ircode[4];//数码管接收缓冲区
/**************************************************************************
函数功能：设定定时器1为红外功能实现定时器
入口参数：无
返回值  ：无
**************************************************************************/
void InitInfrared()
{
	//AUXR &= 0x7F;//设置定时器为12T模式
	IR_INPUT = 1;
	TMOD = (TMOD & 0x0F) | 0x10;
	TR1 = 0;
	ET1 = 0;//定时器1中断关闭
	IT1 = 1;//设置外部中断1为下降沿触发
}
/**************************************************************************
函数功能：获取NEC协议高电平持续时间
入口参数：无
返回值  ：无
**************************************************************************/
u16 GetHighTime()
{
	TH1 = 0;
	TL1 = 0;
	TR1 = 1;
	while(IR_INPUT)
	{
		if(TH1 >= 0x40) break;//高电平时间持续过长（约18ms）则跳出
	}
	TR1 = 0;
	
	return (TH1 * 256 + TL1);
}
/**************************************************************************
函数功能：获取NEC协议低电平持续时间
入口参数：无
返回值  ：无
**************************************************************************/
u16 GetLowTime()
{
	
	TH1 = 0;
	TL1 = 0;
	TR1 = 1;
	while(!IR_INPUT)
	{
		if(TH1 >= 0x40) break;//低电平时间持续过长（约18ms）则跳出
	}
	TR1 = 0;
	
	return (TH1 * 256 + TL1);
}
/**************************************************************************
函数功能：INT1外部中断服务函数,接收红外并解码
入口参数：无
返回值  ：无
**************************************************************************/
void ServiceINT1() interrupt 2
{
	u8 i, j;
	u8 byt;
	u16 time;
	
	SMG_Display();
	
	time = GetLowTime();
	if( (time < 7833) || (time > 8755) )//判断是否为误码
	{
		IE1 = 0;//清除外部中断标志
		return;
	}
	
	time = GetHighTime();
	if( (time < 3686) || (time > 4608) )//判断是否为误码
	{
		IE1 = 0;
		return;
	}
	
	for(i = 0; i < 4; i ++)
	{
		for(j = 0; j < 8; j ++)
		{
			//先判断每位的数据中的低电平是否超时
			time  = GetLowTime();
			if( (time < 313) || (time > 718) )
			{
				IE1 = 0;
				return;
			}
			//接收判断每位高电平时间判断值
			time  = GetHighTime();
			if( (time > 313) && (time < 718) )//值为0
			{
				byt >>= 1;
			}
			else if( (time > 1345) || (time < 1751) )//值为1
			{
				byt >>= 1;
				byt |= 0x80;
			}
			else//不符合上述两种条件即为误码
			{
				IE1 = 0;
				return;
			}
		}
		ircode[i] = byt;
	}
	irflag = 1;
	IE1 = 0;
	
}
/**************************************************************************
函数功能：在数码管显示用户码和键码
入口参数：无
返回值  ：无
**************************************************************************/
void IrInfoDisplay()
{
	if(irflag)
	{
		irflag = 0;
		SMG_Buff[0] = SMG[ircode[0] >> 4];
		SMG_Buff[1] = SMG[ircode[0]&0x0F];
		
		SMG_Buff[6] = SMG[ircode[2] >> 4];
		SMG_Buff[7] = SMG[ircode[2]&0x0F];
	}
}