#include "Sys.h"

sbit DQ = P1^4;  //单总线接口

//单总线延时函数
void Delay_OneWire(unsigned int t)  //IAP15F2K61S2
{
	/*******************************/
	t = t * 7;
	/*******************************/
	while(t--);
}

//通过单总线向DS18B20写一个字节
void Write_DS18B20(unsigned char dat)
{
	unsigned char i;
	/*******************************/
	EA = 0;
	/*******************************/
	for(i=0;i<8;i++)
	{
		DQ = 0;
		DQ = dat&0x01;
		Delay_OneWire(5);
		DQ = 1;
		dat >>= 1;
	}
	Delay_OneWire(5);
	/*******************************/
	EA = 1;
	/*******************************/
}

//从DS18B20读取一个字节
unsigned char Read_DS18B20(void)
{
	unsigned char i;
	unsigned char dat;
	/*******************************/
  EA = 0;
	/*******************************/
	
	for(i=0;i<8;i++)
	{
		DQ = 0;
		dat >>= 1;
		DQ = 1;
		if(DQ)
		{
			dat |= 0x80;
		}	    
		Delay_OneWire(5);
	}
	/*******************************/
	EA = 1;
	/*******************************/
	return dat;
}
/**************************************************************************
函数功能：DS18B20设备初始化,发送检测存在脉冲
入口参数：无
返回值  ：0存在DS18B20,1不存在DS18B20
**************************************************************************/
bit InitDS18B20(void)
{
  	bit initflag = 0;
  	
  	DQ = 1;
  	Delay_OneWire(12);
  	DQ = 0;
  	Delay_OneWire(80);
  	DQ = 1;
  	Delay_OneWire(10); 
    initflag = DQ;     
  	Delay_OneWire(5);
	
	
  	return initflag;
}
/**************************************************************************
函数功能：DS18B20设备启动(温度转换)
入口参数：无
返回值  ：无
**************************************************************************/

/*******************************/
bit Start_DS18B20()
{
	bit ack;
	ack = InitDS18B20();
	if(!ack)
	{
		Write_DS18B20(0xCC);//跳过片选直接控制总线上的所有器件
		Write_DS18B20(0x44);//温度转换指令
	}
	return ~ack;
}
/*******************************/

/**************************************************************************
函数功能：DS18B20设备温度测量精度及测量阈值设置
入口参数：无
返回值  ：无
**************************************************************************/

/*******************************/
//bit Config_DS18B20()
//{
//	bit ack;
//	ack = InitDS18B20();
//	if(ack == 0)
//	{
//		Write_DS18B20(0xCC);
//		
//		Write_DS18B20(0x4E);//写暂存器指令4E
//		Write_DS18B20(0x4B);//写高速缓存器TH高温限值75度
//		Write_DS18B20(0x00);//写高速缓存器TL低温限值0度
//		Write_DS18B20(0x7f);//写配置寄存器4
//												//0x1f ： 0.5000°C  转换时间93.75ms
//												//0x3f ： 0.2000°C  转换时间187.5ms
//												//0x5f ： 0.1250°C  转换时间375ms
//												//0x7f ： 0.0625°C  转换时间750ms//上电默认模式
//	}
//	return ~ack;
//}
/*******************************/

/**************************************************************************
函数功能：温度数据解析
入口参数：无
返回值  ：无
**************************************************************************/

/*******************************/
void Temp_Get()
{
	bit ack;
	u8 LSB , MSB;
	u8 index;
	u32 temp;
	ack = InitDS18B20();
	if(!ack)
	{
		Write_DS18B20(0xCC);							//跳过ROM设置
		Write_DS18B20(0xBE);							//读取暂存器指令
		LSB = Read_DS18B20();							//读取低八位
		MSB = Read_DS18B20();							//读取高八位
		temp = ( ((u32)MSB) << 8) + LSB;	//数据组合
		temp *= 625;											//将DS18B20原始数据转化为温度数据
		//temp >>= 4;											//清除小数位
		for(index = 0; index < 7; index ++)
		{//清空数码管缓冲区
			SMG_Buff[index] = 0xFF;
		}
		//分离数位
		SMG_Buff[1] = SMG[temp / 100000];	
		SMG_Buff[2] = SMG[(temp / 10000) % 10] & 0x7F;
		SMG_Buff[3] = SMG[(temp / 1000) % 10];
		SMG_Buff[4] = SMG[(temp / 100) % 10];
		SMG_Buff[5] = SMG[(temp / 10) % 10];
		SMG_Buff[6] =	SMG[temp % 10];
		SMG_Buff[7] = 0xC6;								//C
	}
	Start_DS18B20();
}
/*******************************/
